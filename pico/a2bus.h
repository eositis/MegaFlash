#ifndef _A2BUS_H
#define _A2BUS_H

#ifdef PICO_RP2040
#include "a2bus_rp2040.pio.h"	//Generated by pio assembler
#else
#include "a2bus_rp2350.pio.h"	//Generated by pio assembler
#endif

#include "hardware/pio.h"
#include "hardware/sync.h"
#include "pico/platform.h"

#ifdef PICO_RP2040
#define SM_LISTENER 0
#else
#define SM_LISTENER 0
#define SM_A2BUS    1
#endif

#if defined(NDEBUG)
/* Release: USB serial vs Apple bus are mutually exclusive (see misc.c / main.c). */
extern volatile bool g_release_bus_emulation_enabled;
#endif

void InitPIO();

#if defined(NDEBUG)
/* Release: spin without consuming PIO FIFO when bus emulation is off (USB host connected). */
static inline uint32_t GetAppleBusBlocking(void) {
  for (;;) {
    while (!g_release_bus_emulation_enabled) {
      tight_loop_contents();
    }
    if (pio_sm_get_rx_fifo_level(pio0, SM_LISTENER) > 0) {
      return pio_sm_get(pio0, SM_LISTENER);
    }
    tight_loop_contents();
  }
}
#else
static inline uint32_t GetAppleBusBlocking(void) {
  return pio_sm_get_blocking(pio0, SM_LISTENER);
}
#endif

//Update MegaFlash Registers
//Input: chunk - Which chunk of registers 
//               0 for $C0C0-$C0C3, 1 for $C0C4-$C0C7 and so on
//       value - MegaFlash Registers value
static inline void UpdateMegaFlashRegisters(const uint32_t chunk,const uint32_t value) {
#ifdef PICO_RP2040
  pio_sm_put(pio0, chunk, value);
#else
  /* RP2350: direct rxf_putget write — ensure store is visible before SM1 pulls for next 6502
   * cycle (see docs §1d/§1f; ip65 RTR XOR can fail on-bus while UART logs correct emulated bytes). */
  pio0->rxf_putget[SM_A2BUS][chunk] = value;
  __dmb();
  /* Ensure store reaches PIO before SM can mov osr,rxfifo[y] (tighter PIO timing). */
  __asm volatile("dsb sy" ::: "memory");
#endif
}

#endif
